## CMakeLists.txt
```
cmake_minimum_required(VERSION 3.20)
find_package(Zephyr REQUIRED HINTS $ENV{ZEPHYR_BASE})
project(otr128_nrf52)

target_sources(app PRIVATE
    src/main.c
    ../../src/otr128.c
    ../../src/aes128_soft.c
    ../../src/backend_nrf52.c
    ../../src/bench.c
)
target_include_directories(app PRIVATE ../../include)
target_compile_definitions(app PRIVATE OTR128_PLATFORM_NRF52)
```

## prj.conf
```kconfig
CONFIG_SERIAL=y
CONFIG_CONSOLE=y
CONFIG_UART_CONSOLE=y
CONFIG_TIMING_FUNCTIONS=y
CONFIG_NEWLIB_LIBC=y
CONFIG_PRINTK=y
CONFIG_MAIN_STACK_SIZE=8192
```

## src/main.c
```c
#include "otr128_bench.h"

#include <zephyr/kernel.h>
#include <zephyr/sys/printk.h>
#include <zephyr/timing/timing.h>

static timing_t g_timing_start;

static void emit_line(void *user, const char *line) {
    (void)user;
    printk("%s\n", line);
}

static uint64_t nrf_now_ns(void *user) {
    timing_t now;

    (void)user;
    now = timing_counter_get();
    return timing_cycles_to_ns(timing_cycles_get(&g_timing_start, &now));
}

int main(void) {
    otr128_bench_hooks hooks;
    const otr128_backend *hw = otr128_backend_nrf52();

    timing_init();
    timing_start();
    g_timing_start = timing_counter_get();

    hooks.now = nrf_now_ns;
    hooks.user = NULL;
    hooks.emit_line = emit_line;
    for (;;) {
        if (hw != NULL) {
            otr128_run_benchmarks(hw, &hooks);
        }
        otr128_run_benchmarks(otr128_backend_soft(), &hooks);
        k_sleep(K_SECONDS(2));
    }
    return 0;
}
```
